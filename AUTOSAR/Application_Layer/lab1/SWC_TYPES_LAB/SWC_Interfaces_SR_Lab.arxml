AUTOSAR XML (schema 00049)
package /SR_Interface_Lab
  sender receiver interface SRI_Lidar
    data ObjectDistance: type=uint16, init-value=7
  sensor actuator sw component type LidarSensor_SWC
    provide port PP_Lidar: provided-interface=SRI_Lidar
  application sw component type Lidar_Algo_SWC
    require port RP_Lidar: required-interface=SRI_Lidar
